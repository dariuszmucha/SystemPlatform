/*
 * libn5110.c
 *
 * Created: 29/01/2016 21:39:53
 *  Author: dariusz.mucha
 */ 

#include "libn5110.h"
#include "libspi.h"
#include "os_delay.h"
#include "os_hal.h"

#define N5110_FONT_HEIGHT	8
#define N5110_FONT_WIDTH	6
#define N5110_LINES			48 / N5110_FONT_HEIGHT
#define N5110_CHAR_PER_LINE	84 / N5110_FONT_WIDTH

static const uint8_t font_table[][N5110_FONT_WIDTH] = {
	{0x00, 0x00, 0x00, 0x00, 0x00, 0x00},		// NULL
	{0x7C, 0x0A, 0x09, 0x0A, 0x7C, 0x00},		// A
	{0x7F, 0x49, 0x49, 0x49, 0x76, 0x00},		// B
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	{0x1F, 0x15, 0x0A, 0x00, 0x00, 0x00},		// Z
};

static const uint8_t ascii_lut[] = {
 0,  0,  0,  0,  0,  0,  0,  0,  0,  0,  0,  0,  0,  0,  0,  0, // 0x00 - 0x0F
 0,  0,  0,  0,  0,  0,  0,  0,  0,  0,  0,  0,  0,  0,  0,  0, // 0x10 - 0x1F
 0,  0,  0,  0,  0,  0,  0,  0,  0,  0,  0,  0,  0,  0,  0,  0, // 0x20 - 0x2F
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 0,  0,  0,  0,  0,  0,  0,  0,  0,  0,  0,  0,  0,  0,  0,  0, // 0x70 - 0x7F
};

static void N5110_clear(void)
{
	uint8_t i = 0;
	for(i = 0; i < N5110_LINES * N5110_CHAR_PER_LINE; i++)
	{
		N5110_Print(" \0");
	}
}

void N5110_Init(void)
{
	N5110_PINS_OUT |= (1 << N5110_RST) | (1 << N5110_DC) | (1 << N5110_SCE);
	SPI_MasterInit(spi_clock_div_4, 1);
	N5110_PINS_SET &= ~(1 << N5110_RST) & ~(1 << N5110_DC) & ~(1 << N5110_SCE);
	
	os_delay_ms(1);
	N5110_PINS_SET |= (1 << N5110_RST);
	
	SPI_MasterTransmit(0x21);
	SPI_MasterTransmit(0xB1);
	SPI_MasterTransmit(0x04);
	SPI_MasterTransmit(0x14);
	SPI_MasterTransmit(0x20);
	SPI_MasterTransmit(0x0C);
	
	N5110_clear();
}

void N5110_Print(const char *data)
{
	N5110_PINS_SET |= (1 << N5110_DC);
	uint8_t i = 0;
	uint8_t j = 0;
	while(data[i] != 0)
	{
		const uint8_t* font = font_table[ ascii_lut[ (uint8_t)data[i]] ];
		for(j = 0; j < N5110_FONT_WIDTH; j++)
		{
			SPI_MasterTransmit(font[j]);
		}
		i++;
	}
}